## config/boards/shields/redox/Kconfig.defconfig
```kconfig
if SHIELD_REDOX_CENTRAL_DONGLE || SHIELD_REDOX_CENTRAL_LEFT

config ZMK_KEYBOARD_NAME
    default "REDOX"

config ZMK_SPLIT_ROLE_CENTRAL
    default y

endif

if ZMK_DISPLAY

config I2C
    default y

config SSD1306
    default y

choice ZMK_DISPLAY_WORK_QUEUE
    default ZMK_DISPLAY_WORK_QUEUE_DEDICATED
endchoice

endif

if LVGL

config LV_Z_VDB_SIZE
    default 64

config LV_DPI_DEF
    default 132

config LV_Z_BITS_PER_PIXEL
    default 1

choice LV_COLOR_DEPTH
    default LV_COLOR_DEPTH_1
endchoice

endif

if SHIELD_REDOX_CENTRAL_DONGLE || SHIELD_REDOX_CENTRAL_LEFT || SHIELD_REDOX_PERIPHERAL_LEFT || SHIELD_REDOX_PERIPHERAL_RIGHT

config ZMK_SPLIT
    default y

endif
```
